## firmware/main/Kconfig.projbuild
```kconfig
menu "Fall of Duty Lite"

config FOD_BOARD_DIAGNOSTIC
    bool "Run the numbered framebuffer diagnostic instead of the game"
    default n

config FOD_DIAGNOSTIC_SCANOUT_ONLY
    bool "Disable PPA in the framebuffer diagnostic"
    depends on FOD_BOARD_DIAGNOSTIC
    default n

config FOD_CLASSIC_VISUALS
    bool "Use the original low-cost texture and sky renderer"
    depends on !FOD_BOARD_DIAGNOSTIC
    default n

config FOD_REPLAY_SCENE
    string "SD replay scene (empty for live duel, long-lane or apache)"
    depends on !FOD_BOARD_DIAGNOSTIC
    default ""

config FOD_REPLAY_JOURNAL
    bool "Write game replay journal instead of running performance capture"
    depends on !FOD_BOARD_DIAGNOSTIC
    default n

config FOD_REPLAY_FRAME_ONLY
    bool "Measure only total frame work during replay capture"
    depends on !FOD_BOARD_DIAGNOSTIC && !FOD_REPLAY_JOURNAL && FOD_REPLAY_SCENE != ""
    default n

config FOD_REPLAY_COMPACT
    bool "Use 320x180 for the SD replay"
    depends on !FOD_BOARD_DIAGNOSTIC
    default n

config FOD_LATENCY_GPIO
    int "Optional report-receipt GPIO (-1 disables)"
    range -1 54
    default -1

endmenu
```

## firmware/sdkconfig.defaults
```kconfig
CONFIG_ESP32P4_SELECTS_REV_LESS_V3=y
CONFIG_ESP_DEFAULT_CPU_FREQ_MHZ_360=y
CONFIG_FREERTOS_HZ=1000
CONFIG_ESPTOOLPY_FLASHSIZE_16MB=y
CONFIG_PARTITION_TABLE_SINGLE_APP_LARGE=y
CONFIG_SPIRAM=y
CONFIG_SPIRAM_SPEED_200M=y
CONFIG_SPIRAM_USE_MALLOC=y
CONFIG_SPIRAM_MALLOC_ALWAYSINTERNAL=4096
CONFIG_SPIRAM_MALLOC_RESERVE_INTERNAL=65536
CONFIG_COMPILER_OPTIMIZATION_PERF=y
CONFIG_COMPILER_CXX_EXCEPTIONS=y
CONFIG_ESP_MAIN_TASK_STACK_SIZE=16384
CONFIG_ESP_CONSOLE_UART_CUSTOM=y
CONFIG_ESP_CONSOLE_UART_CUSTOM_NUM_0=y
CONFIG_ESP_CONSOLE_UART_TX_GPIO=37
CONFIG_ESP_CONSOLE_UART_RX_GPIO=38
CONFIG_ESP_CONSOLE_SECONDARY_NONE=y
CONFIG_FATFS_LFN_HEAP=y
CONFIG_FATFS_MAX_LFN=64
CONFIG_APP_REPRODUCIBLE_BUILD=y
```
